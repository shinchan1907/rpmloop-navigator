## firmware/main/Kconfig.projbuild
```kconfig
menu "MiniNav-Mini (Android Auto minimap)"

    config AAM_AP_SSID
        string "WiFi access point name (phone joins this)"
        default "RPL Loop"

    config AAM_AP_PASSWORD
        string "WiFi access point password (8+ characters)"
        default "88888888"

    config AAM_AP_CHANNEL
        int "WiFi channel"
        range 1 13
        default 6

    config AAM_HOTSPOT_SSID
        string "Phone hotspot name the board joins (alternative to the access point)"
        default "RPL Loop"

    config AAM_HOTSPOT_PASSWORD
        string "Phone hotspot password"
        default "88888888"

    config AAM_PHONE_PORT
        int "Phone headunit server TCP port"
        default 5277

    config AAM_VIDEO_DENSITY
        int "Video density (dpi). Higher = bigger map labels and buttons"
        range 100 320
        default 200

    config AAM_VIDEO_MARGIN_W
        int "Video margin width (pixels of 800 left unused by Android Auto, split both sides)"
        range 0 400
        default 160
        help
            800x480 minus 2x80 px = 640x480 (4:3) UI area, same shape as this 320x240 LCD.

    config AAM_HIDE_RAIL
        bool "Hide Android Auto's app rail (crop it off; map fills the whole screen)"
        default y
        help
            The left app-rail is 80 dp wide. With this on the board requests a UI area that much
            wider and crops the rail column out so only the map is visible.

    config AAM_VIDEO_MARGIN_H
        int "Video margin height"
        range 0 240
        default 0

    config AAM_MAX_UNACKED
        int "Video frames the phone may send before our ACK (keep at 1 for 2 MB PSRAM)"
        range 1 4
        default 1

    config AAM_RIGHT_HAND_DRIVE
        bool "Right-hand drive (India, UK, Japan...)"
        default y

    config AAM_MOTORCYCLE
        bool "Claim a motorcycle (no mic; Maps gives two-wheeler directions)"
        default n

    config AAM_SPEECH_AUDIO
        bool "Announce a speech audio sink (nav voice sent to board and silently dropped)"
        default n

    config AAM_LOG_MESSAGES
        bool "Log every Android Auto message (channel, id, length, first 64 bytes)"
        default n

endmenu
```
